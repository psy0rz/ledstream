## main/Kconfig.projbuild
```kconfig
# Copied and stripped from IDF basic ethernet example

menu "LEDSTREAM CONFIG"

    config LEDSTREAM_WIFI_SSID
        string "Wifi SSID"
        default ""
        help
            Leave blank to disable wifi

    config LEDSTREAM_WIFI_PASS
        string "Wifi Password"
        default ""

    config LEDSTREAM_GPIO_RANGE_MIN
        int
        default 0

    config LEDSTREAM_GPIO_RANGE_MAX
        int
        default 33 if IDF_TARGET_ESP32
        default 46 if IDF_TARGET_ESP32S2
        default 19 if IDF_TARGET_ESP32C3
        default 48 if IDF_TARGET_ESP32S3

    config LEDSTREAM_USE_INTERNAL_ETHERNET
        depends on IDF_TARGET_ESP32 || IDF_TARGET_ESP32S3
        select ETH_USE_ESP32_EMAC
        bool "Internal EMAC"
        default "y"
        help
            Use internal Ethernet MAC controller.

    if LEDSTREAM_USE_INTERNAL_ETHERNET
        choice LEDSTREAM_ETH_PHY_MODEL
            prompt "Ethernet PHY Device"
            default LEDSTREAM_ETH_PHY_LAN87XX
            help
                Select the Ethernet PHY device to use in the example.



            config LEDSTREAM_ETH_PHY_LAN87XX
                bool "LAN87xx"
                help
                    NOTE: Defaults are for WT32-ETH01 ESP32 (psy0rz)

                    Below chips are supported:
                    LAN8710A is a small footprint MII/RMII 10/100 Ethernet Transceiver with HP Auto-MDIX and
                        flexPWR® Technology.
                    LAN8720A is a small footprint RMII 10/100 Ethernet Transceiver with HP Auto-MDIX Support.
                    LAN8740A/LAN8741A is a small footprint MII/RMII 10/100 Energy Efficient Ethernet Transceiver
                        with HP Auto-MDIX and flexPWR® Technology.
                    LAN8742A is a small footprint RMII 10/100 Ethernet Transceiver with HP Auto-MDIX and
                        flexPWR® Technology.
                    Goto https://www.microchip.com for more information about them.

        endchoice # LEDSTREAM_ETH_PHY_MODEL

        config LEDSTREAM_ETH_MDC_GPIO
            int "SMI MDC GPIO number"
            range LEDSTREAM_GPIO_RANGE_MIN LEDSTREAM_GPIO_RANGE_MAX
            default 23
            help
                Set the GPIO number used by SMI MDC.

        config LEDSTREAM_ETH_MDIO_GPIO
            int "SMI MDIO GPIO number"
            range LEDSTREAM_GPIO_RANGE_MIN LEDSTREAM_GPIO_RANGE_MAX
            default 18
            help
                Set the GPIO number used by SMI MDIO.

        config LEDSTREAM_ETH_PHY_RST_GPIO
            int "PHY Reset GPIO number"
            range -1 LEDSTREAM_GPIO_RANGE_MAX
            default -1
            help
                Set the GPIO number used to reset PHY chip.
                Set to -1 to disable PHY chip hardware reset.

        config LEDSTREAM_ETH_EXT_CLOCK_ACTIVATE
            int "Pin to activate external clock"
            range LEDSTREAM_GPIO_RANGE_MIN LEDSTREAM_GPIO_RANGE_MAX
            default 16
            help
               This is needed for WT32-ETH01 ESP32 (psy0rz)


        config LEDSTREAM_ETH_PHY_ADDR
            int "PHY Address"
            range 0 31
            default 1
            help
                Set PHY address according your board schematic.
    endif # LEDSTREAM_USE_INTERNAL_ETHERNET



    config LEDSTREAM_UDP_BUFFERS
        int "UDP buffers"
        range 1 600
        default 50

    config LEDSTREAM_FIRMWARE_UPGRADE_URL
        string "Firmware Upgrade URL"
        default "http://192.168.13.135:8080/ledstream.bin"
        help
            URL of server which hosts the firmware image.

    config LEDSTREAM_LEDDER_URL
        string "Ledder URL"
        default "http://192.168.13.154:3000"
        help
            URL of server which hosts the firmware image.


    choice
            prompt "Led controller type"
            default LEDSTREAM_MODE_WS2812

        config LEDSTREAM_MODE_WS2812
            bool "Use WS2812 leds with FastLED-IDF"
            depends on IDF_TARGET_ESP32

        config LEDSTREAM_MODE_HUB75
            bool "Use HUB75 ledboard with ESP32-HUB75-MatrixPanel-DMA"


    endchoice



    ########################################## WS2812 stuff

    config LEDSTREAM_CHANNELS
        int "Channels"
        range 1 8
        default 8
        depends on LEDSTREAM_MODE_WS2812


    config LEDSTREAM_LEDS_PER_CHANNEL
        int "Leds per channel"
        range 1 600
        default 512
        depends on LEDSTREAM_MODE_WS2812

    config LEDSTREAM_CHANNEL0_PIN
        int "Channel 0 pin"
        range -1 LEDSTREAM_GPIO_RANGE_MAX
        default 12
        help
            Use -1 to disable. (only to this with the last channels)
        depends on LEDSTREAM_MODE_WS2812

    config LEDSTREAM_CHANNEL1_PIN
        int "Channel 1 pin"
        range -1 LEDSTREAM_GPIO_RANGE_MAX
        default 2
        help
            Use -1 to disable. (only to this with the last channels)
        depends on LEDSTREAM_MODE_WS2812

    config LEDSTREAM_CHANNEL2_PIN
        int "Channel 2 pin"
        range -1 LEDSTREAM_GPIO_RANGE_MAX
        default 15
        help
            Use -1 to disable. (only to this with the last channels)
        depends on LEDSTREAM_MODE_WS2812

    config LEDSTREAM_CHANNEL3_PIN
        int "Channel 3 pin"
        range -1 LEDSTREAM_GPIO_RANGE_MAX
        default 4
        help
            Use -1 to disable. (only to this with the last channels)
        depends on LEDSTREAM_MODE_WS2812

    config LEDSTREAM_CHANNEL4_PIN
        int "Channel 4 pin"
        range -1 LEDSTREAM_GPIO_RANGE_MAX
        default 14
        help
            Use -1 to disable. (only to this with the last channels)
        depends on LEDSTREAM_MODE_WS2812

    config LEDSTREAM_CHANNEL5_PIN
        int "Channel 5 pin"
        range -1 LEDSTREAM_GPIO_RANGE_MAX
        default 17
        help
            Use -1 to disable. (only to this with the last channels)
        depends on LEDSTREAM_MODE_WS2812

    config LEDSTREAM_CHANNEL6_PIN
        int "Channel 6 pin"
        range -1 LEDSTREAM_GPIO_RANGE_MAX
        default 32
        help
            Use -1 to disable. (only to this with the last channels)
        depends on LEDSTREAM_MODE_WS2812

    config LEDSTREAM_CHANNEL7_PIN
        int "Channel 7 pin"
        range -1 LEDSTREAM_GPIO_RANGE_MAX
        default 33
        help
            Use -1 to disable. (only to this with the last channels)
        depends on LEDSTREAM_MODE_WS2812


    config LEDSTREAM_MAX_MILLIAMPS
        int "Max milliamps"
        range -1 100000
        default -1
        depends on LEDSTREAM_MODE_WS2812

    ########################################## HUB75 stuff

    config LEDSTREAM_WIDTH
        int "HUB75 display width"
        default 64
        depends on LEDSTREAM_MODE_HUB75

    config LEDSTREAM_HEIGHT
        int "HUB75 display height"
        default 32
        depends on LEDSTREAM_MODE_HUB75

    config LEDSTREAM_CHAIN
        int "HUB75 chain length"
        default 1
        depends on LEDSTREAM_MODE_HUB75


    config LEDSTREAM_R1
        int "HUB75 R1 pin"
        default 25
        depends on LEDSTREAM_MODE_HUB75

    config LEDSTREAM_G1
        int "HUB75 G1 pin"
        default 26
        depends on LEDSTREAM_MODE_HUB75

    config LEDSTREAM_B1
        int "HUB75 B1 pin"
        default 27
        depends on LEDSTREAM_MODE_HUB75


    config LEDSTREAM_R2
        int "HUB75 R2 pin"
        default 14
        depends on LEDSTREAM_MODE_HUB75

    config LEDSTREAM_G2
        int "HUB75 G2 pin"
        default 12
        depends on LEDSTREAM_MODE_HUB75

    config LEDSTREAM_B2
        int "HUB75 B2 pin"
        default 13
        depends on LEDSTREAM_MODE_HUB75

    config LEDSTREAM_A
        int "HUB75 A pin"
        # originaly 23
        default 02
        depends on LEDSTREAM_MODE_HUB75

    config LEDSTREAM_B
        int "HUB75 B pin"
        # originaly 19
        default 00
        depends on LEDSTREAM_MODE_HUB75

    config LEDSTREAM_C
        int "HUB75 C pin"
        default 5
        depends on LEDSTREAM_MODE_HUB75

    config LEDSTREAM_D
        int "HUB75 D pin"
        default 17
        depends on LEDSTREAM_MODE_HUB75

    config LEDSTREAM_E
        int "HUB75 E pin (for 1/32 scan panels)"
        default -1
        depends on LEDSTREAM_MODE_HUB75


    config LEDSTREAM_CLK
        int "HUB75 CLK pin"
        default 16
        depends on LEDSTREAM_MODE_HUB75
    config LEDSTREAM_LAT
        int "HUB75 LAT pin"
        default 4
        depends on LEDSTREAM_MODE_HUB75
    config LEDSTREAM_OE
        int "HUB75 OE pin"
        default 15
        depends on LEDSTREAM_MODE_HUB75




endmenu
```
